## sony-gplsource/vendor/nxp-opensource/uboot-imx/board/freescale/imx8mm_dmp1/Kconfig
```kconfig
if TARGET_IMX8MM_DMP1 || TARGET_IMX8MM_DDR4_EVK

config SYS_BOARD
	default "imx8mm_dmp1"

config SYS_VENDOR
	default "freescale"

config SYS_CONFIG_NAME
	default "imx8mm_dmp1"

config DMP
	bool "Define product as DMP"
	help
	  Define product as DMP. This is used to enable the codes
	  for DMP specific feature.

config SUPPORT_SERVICE_MODE
	bool "Enable booting up the service mode"
	help
	  Enable booting up the service mode. Service mode is a
	  generic term for initialize, diag and service mode.

config ICX_FASTBOOT_MAGIC_KEY
	bool "Enable pressing magic keys to enter fastboot mode"
	help
	  Enable pressing magic keys (usually play control keys) to
	  enter fastboot mode. To start firmware download mode
	  (so called uuu) and debug facilities.
	  It's may be better that enable this option only with
	  debug/developing build.

config ICX_SDCARD_POWER_DOWN_RESET
	bool "Reset SD Card by power down"
	default n
	help
	  Reset SD Card by power down. But this causes power line
	  glitch on SD Card power line and reverse voltage between
	  CMD and VDD line.
	  We recommend that this option should be 'N'.

config ICX_ERRATA_BD71837_REVA0
	bool "Workaround for REVA0 BUG"
	default y
	help
	  Enable a workaround provided by ROHM.
	  We recommend that this option should be 'Y'.

config ICX_DEAD_BATTERY
	bool "Enable dead battery control"
	default y
	help
	  Enable dead battery control.
	  We recommend that this option should be 'Y'.

config ICX_OTG_ALL_SUSPEND
	bool "Suspend all OTG channel at boot"
	default y
	help
	  Say Y to suspend all OTG channels at boot.
	  It may reduce power consumption at kernel suspend.
	  Especially, kernel doesn't use one or more OTG channel.
	  Note: Fastboot is still available (updating firmware by uuu).
	  Say N to don't suspend OTG channgels at boot.
	  Use this option when enable all OTG channel by kernel.

config CMD_SRKCHK
	bool "Enable srkchk_d and srkchk_p command"
	default y
	help
	  Enable srkchk_d and srkchk_p command.
	  We recommend that this option should be 'Y'.

config ICX_DISABLE_FORCE_UNLOCK
	bool "Disable force unlock mode"
	help
	  Disable force unlock mode for ship fw.

config ICX_UNLOCKED_LOGO
	bool "Display logo at boot if device is oem unlocked"
	default y
	help
	  If device is oem unlocked, device have to inform user.
	  We recommend that this option should be 'Y'.

config ICX_UNLOCKED_LOGO_OFFSET
	hex "unlocked logo block offset in bootloader"
	default 0x2000 if ICX_UNLOCKED_LOGO
	help
	  Offset (number of blocks) of unlocked logo bmp data
	  in bootloader partition. Default value is 4MB.

config ICX_UNLOCKED_LOGO_COUNT
	hex "unlocked logo block count of bmp"
	default 0x1800 if ICX_UNLOCKED_LOGO
	help
	  Size of unlocked bmp data (number of blocks).
	  Default value is 3MB.

source "board/freescale/common/Kconfig"

endif
```

## sony-gplsource/vendor/nxp-opensource/uboot-imx/board/freescale/imx8mm_evk/Kconfig
```kconfig
if TARGET_IMX8MM_EVK || TARGET_IMX8MM_DDR4_EVK

config SYS_BOARD
	default "imx8mm_evk"

config SYS_VENDOR
	default "freescale"

config SYS_CONFIG_NAME
	default "imx8mm_evk"

config ICX_OTG_ALL_SUSPEND
	bool "Suspend all OTG channel at boot"
	default n
	help
	  Say Y to suspend all OTG channels at boot.
	  It may reduce power consumption at kernel suspend.
	  Especially, kernel doesn't use one or more OTG channel.
	  Note: Fastboot is still available (updating firmware by uuu).
	  Say N to don't suspend OTG channgels at boot.
	  Use this option when enable all OTG channel by kernel.

source "board/freescale/common/Kconfig"

endif
```

## sony-gplsource/vendor/nxp-opensource/uboot-imx/configs/imx8mm_dmp1_android_uuu_defconfig
```kconfig
CONFIG_ARM=y
CONFIG_ARCH_IMX8M=y
CONFIG_SYS_TEXT_BASE=0x40200000
CONFIG_SYS_MALLOC_F_LEN=0x2000
# CONFIG_USB_TCPC is not set
CONFIG_TARGET_IMX8MM_DMP1=y
CONFIG_DMP=y
CONFIG_DEFAULT_DEVICE_TREE="sony-imx8mm-dmp1"
CONFIG_SYS_EXTRA_OPTIONS="IMX_CONFIG=arch/arm/mach-imx/spl_sd.cfg,SPL_TEXT_BASE=0x7E1000,ANDROID_SUPPORT"
CONFIG_FIT=y
CONFIG_SPL_LOAD_FIT=y
CONFIG_EFI_PARTITION=y
CONFIG_ARCH_MISC_INIT=y
CONFIG_SPL=y
CONFIG_SPL_BOARD_INIT=y
CONFIG_SPL_MMC_SUPPORT=y
CONFIG_HUSH_PARSER=y
CONFIG_OF_LIBFDT=y
CONFIG_FS_FAT=y
CONFIG_CMD_EXT2=y
CONFIG_CMD_EXT4=y
CONFIG_CMD_EXT4_WRITE=y
CONFIG_CMD_FAT=y
CONFIG_ENV_IS_IN_MMC=y
# CONFIG_CMD_SF is not set
CONFIG_CMD_I2C=y
CONFIG_CMD_GPIO=y
CONFIG_CMD_CACHE=y
CONFIG_CMD_REGULATOR=y
CONFIG_CMD_MEMTEST=y
CONFIG_OF_CONTROL=y
CONFIG_DM_GPIO=y
CONFIG_DM_I2C=y
CONFIG_SYS_I2C_MXC=y
CONFIG_DM_MMC=y
# CONFIG_DM_PMIC=y
# CONFIG_DM_SPI_FLASH is not set
# CONFIG_SPI_FLASH is not set
# CONFIG_SPI_FLASH_STMICRO is not set
# CONFIG_DM_ETH is not set
# CONFIG_CMD_NET is not set
CONFIG_PINCTRL=y
CONFIG_PINCTRL_IMX8M=y
CONFIG_DM_REGULATOR=y
CONFIG_DM_REGULATOR_FIXED=y
CONFIG_DM_REGULATOR_GPIO=y
CONFIG_DM_SPI=y
# CONFIG_FSL_FSPI is not set
CONFIG_NXP_TMU=y
CONFIG_DM_THERMAL=y
CONFIG_USB=y
CONFIG_DM_USB=y
CONFIG_USB_EHCI_HCD=y
CONFIG_LZ4=y
CONFIG_FLASH_MCUFIRMWARE_SUPPORT=y
CONFIG_MCU_FIRMWARE_AVB_SUPPORT=y
CONFIG_USB_GADGET=y
CONFIG_USB_GADGET_DOWNLOAD=y
CONFIG_SDP_LOADADDR=0x40400000
CONFIG_USB_GADGET_MANUFACTURER="FSL"
CONFIG_USB_GADGET_VENDOR_NUM=0x0525
CONFIG_USB_GADGET_PRODUCT_NUM=0xa4a5
CONFIG_SPL_USB_HOST_SUPPORT=y
CONFIG_SPL_USB_GADGET_SUPPORT=y
CONFIG_SPL_USB_SDP_SUPPORT=y
CONFIG_VIDEO=y
CONFIG_IMX_SEC_MIPI_DSI=y
CONFIG_MISC=y
CONFIG_ICX_NVP_EMMC=y
CONFIG_ICX_PORT_INIT=y
CONFIG_ICX_DMP_BOARD_ID=y
CONFIG_ICX_FASTBOOT_MAGIC_KEY=y
CONFIG_DISABLE_BTN_LONG_PRESS=y
# CONFIG_ICX_SDCARD_POWER_DOWN_RESET is not set
CONFIG_SUPPORT_SERVICE_MODE=y
CONFIG_MAX1704X=y
CONFIG_CMD_BOOT_CM4=y
CONFIG_ICX_DEAD_BATTERY=y
CONFIG_SILENT_CONSOLE=y
CONFIG_BOOTDELAY=0
CONFIG_ICX_STOP_AUTOBOOT_CTRL_C=y
CONFIG_ICX_DDR_FREQ_LIMIT=y
CONFIG_ICX_OTG_ALL_SUSPEND=y
CONFIG_MD5=y
CONFIG_PWD=y
CONFIG_CMD_SRKCHK=y
CONFIG_ICX_UNLOCKED_LOGO=y
CONFIG_ICX_UNLOCKED_LOGO_OFFSET=0x2000
CONFIG_ICX_UNLOCKED_LOGO_COUNT=0x1800
```
